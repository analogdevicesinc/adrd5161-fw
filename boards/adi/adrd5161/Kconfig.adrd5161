## boards/adi/adrd5161/Kconfig.adrd5161
```kconfig
# Copyright (c) 2024 Analog Devices, Inc.
# SPDX-License-Identifier: Apache-2.0

config BOARD_ADRD5161
    select SOC_MAX32662
```

## boards/adi/adrd5161/adrd5161_defconfig
```kconfig
# Copyright (c) 2025 Analog Devices, Inc.
# SPDX-License-Identifier: Apache-2.0

# Enable GPIO
CONFIG_GPIO=y

# Console
CONFIG_CONSOLE=y
CONFIG_UART_CONSOLE=y

# Enable UART
CONFIG_SERIAL=y
CONFIG_UART_INTERRUPT_DRIVEN=y
CONFIG_LOG=y
# Enable I2C
CONFIG_I2C=y
CONFIG_PINCTRL=y
CONFIG_FUEL_GAUGE=y
CONFIG_FUEL_GAUGE_MAX17320=y
CONFIG_MFD=y
CONFIG_CHARGER=y
CONFIG_CHARGER_MAX77961=y

CONFIG_SENSOR=y
CONFIG_SENSOR_MAX31827=y
```

## boards/adi/adrd5161/board.yml
```yaml
board:
  name: adrd5161
  full_name: ADRD5161 BMS module
  vendor: adi
  revision:
    format: letter
    default: A
    revisions:
    - name: A
  socs:
  - name: max32662
```

## drivers/Kconfig
```kconfig
menu "Drivers"
rsource "fuel_gauge/Kconfig"
rsource "charger/Kconfig"
rsource "sensor/Kconfig"
endmenu
```

## drivers/charger/max77961/Kconfig
```kconfig
config CHARGER_MAX77961 
	bool "MAX77961 Charger Driver" 
	default y
	depends on I2C && CHARGER 
	help
	  Enable support for the Maxim MAX77961 USB Type-C Buck-Boost Charger.
```

## drivers/fuel_gauge/max17320/Kconfig
```kconfig
config FUEL_GAUGE_MAX17320
	bool "MAX17320 fuel gauge"
	default y
	depends on FUEL_GAUGE && I2C
	help
	  Enable driver for the MAX17320 fuel gauge device.
```

## drivers/sensor/max31827/Kconfig
```kconfig
config SENSOR_MAX31827
	bool "MAX31827 temperature sensor"
	default y
	depends on SENSOR && I2C
	help
	  Enable driver for the MAX31827 temperature sensor.
```

## dts/bindings/charger/adi,max77961.yaml
```yaml
description: |
  Maxim Integrated MAX77961 USB Type-C Buck-Boost Charger for 2S/3S Li-ion Batteries.
compatible: "adi,max77961"

include: [i2c-device.yaml, battery.yaml]
properties:
  constant_charge_current_max_microamp:
    type: int
    required: false
    description: Maximum constant charge current in microamperes (e.g. 6000000 for 6A).
  reg:
    required: true
```

## dts/bindings/fuel_gauge/adi,max17320.yaml
```yaml
# Device tree binding for MAX17320 fuel gauge
description: |
    Maxim Integrated MAX17320 2S-4S ModelGauge m5 EZ Fuel Gauge
    with Protector, Internal Self-Discharge Detection, and SHA-256 Authentication

compatible: "adi,max17320"

include: [i2c-device.yaml, fuel-gauge.yaml]
properties:
    reg:
        required: true
```
